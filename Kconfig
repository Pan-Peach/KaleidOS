## Kconfig
```kconfig
mainmenu "KaleidOS Configuration"

source "os/arch/Kconfig"
source "os/core/Kconfig"
source "os/components/Kconfig"
```

## os/components/Kconfig
```kconfig
# Boot selects one artifact; that component owns system composition.

config TEST_COMPONENTS
    bool "Include test components in the embedded package"
    default y if SELFTEST
    default n
    help
      Include CoreTest and test-only fixtures. Normal system packages contain
      production components only. Test profiles select this explicitly.

config BOOT_COMPONENT
    string "Initial component artifact (empty for Core Monitor)"
    default "init" if (ARCH_RISCV32 || ARCH_RISCV64) && !SELFTEST
    default ""
    help
      Artifact basename in the embedded component store, without .kcomp.
      Boot loads it as KernelNative after Core and the store are ready.
      Empty selects Core Monitor. A load/create failure also returns to the
      monitor for diagnosis. Names may contain letters, digits, _ and -.
```

## os/core/Kconfig
```kconfig
# KaleidOS Core options.
#
# Core-level build switches that change the Core's own behaviour or the boot
# image.  Component selection does NOT belong here -- see os/components/Kconfig.

menu "Core options"

config PREEMPT
	bool "Preemptive scheduling"
	default n
	help
	  Let the scheduler preempt a running task on a timer interrupt instead
	  of switching only cooperatively at explicit yield points.  Off by
	  default: cooperative round-robin is the current baseline.

# SMP is not a build switch: UP is just "SMP with one CPU" -- per-CPU state is
# always compiled and degenerates to CPU 0.  The compile-time **capacity** is
# `MAX_CPUS` below; the runtime count comes from MachineInfo at boot.
config MAX_CPUS
	int "Maximum number of CPUs (compile-time capacity)"
	default 8
	range 1 64
	help
	  Compile-time capacity for the per-CPU arrays: Core's `MachineInfo`
	  (`cpu_info`) and arch's per-CPU entry records / trap stacks.  It is a
	  **capacity**, not the detected count -- the real count comes from the
	  discovered MachineInfo at boot and must be <= this value.

	  It is a build config (not a plain crate constant) because both `arch`
	  (the leaf) and `core` need the same value, but `core` depends on `arch`
	  and not the other way around, so the constant must live below `core`.
	  `arch/build.rs` turns this symbol into the Rust constant `arch::MAX_CPUS`
	  (mirrored as CONFIG_MAX_CPUS by genmk.py), and `core::machine` re-exports
	  it, so there is exactly one definition.

endmenu

menu "Debugging / Testing"

config TRACE
	bool "Structured Core trace"
	default y
	help
	  Compile the structured Core trace (the TraceEvent ring behind
	  trace::emit / trace::visit_since).  It is the evidence base for CoreTest
	  event-sequence assertions and for cost attribution.

	  Turning it OFF makes trace::emit an inlined no-op: nothing is recorded and
	  the hot path pays zero cost.  Do that for performance measurement --
	  tracing perturbs exactly the paths a benchmark wants to measure.

config TRACE_CAPACITY
	int "Trace ring capacity (records)"
	default 1024
	range 64 8192
	help
	  Fixed capacity of the structured Core trace ring, in records.  The ring
	  storage lives in Core BSS whether or not CONFIG_TRACE is on, so this
	  still sizes the image when tracing is compiled out.

	  The value travels to the Core crate as one resolved number (not a Cargo
	  feature): genmk.py mirrors it as CONFIG_TRACE_CAPACITY, the Makefile
	  passes that to os/core/build.rs, and build.rs validates it before writing
	  the Rust constant.  1024 records cover a full boot plus one core_test
	  round.

config SELFTEST
	bool "Build the ArchTest selftest image"
	default n
	depends on VM_MMU
	help
	  Swap the boot entrypoint so the image runs the architectural selftests
	  (ArchTest) instead of entering the interactive Core Monitor.  Requires
	  the MMU profile: the selftests exercise page tables and do not build
	  against NoMMU.

endmenu
```
